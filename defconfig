## defconfig
```kconfig
# CONFIG_RT_USING_DEBUG is not set
CONFIG_RT_CONSOLE_DEVICE_NAME="uart1"
# CONFIG_RT_USING_DFS is not set
CONFIG_RT_USING_USB_DEVICE=y
CONFIG__RT_USB_DEVICE_CDC=y
CONFIG_BSP_USING_UART6=y
CONFIG_BSP_UART6_RX_USING_DMA=y
CONFIG_BSP_USING_CAN=y
CONFIG_BSP_USING_CAN1=y
CONFIG_BSP_USING_CAN2=y
CONFIG_BSP_USING_TIM=y
CONFIG_BSP_USING_TIM4=y
CONFIG_BSP_USING_PWM=y
CONFIG_BSP_USING_PWM1=y
CONFIG_BSP_USING_PWM1_CH2=y
CONFIG_BSP_USING_PWM10=y
CONFIG_BSP_USING_PWM10_CH1=y
CONFIG_BSP_USING_SPI=y
CONFIG_BSP_USING_SPI1=y
CONFIG_BSP_USING_I2C1=y
# CONFIG_BSP_USING_REFEREE_TASK is not set
```
